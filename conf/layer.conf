## conf/layer.conf
```bitbake
# We have a conf and classes directory, add to BBPATH
BBPATH .= ":${LAYERDIR}"

# We have a recipes-* directories, add to BBFILES
BBFILES += "${LAYERDIR}/recipes-*/*/*.bb \
	${LAYERDIR}/recipes-*/*/*.bbappend"

BBFILE_COLLECTIONS += "mender-qemu"
BBFILE_PATTERN_mender-qemu = "^${LAYERDIR}/"
BBFILE_PRIORITY_mender-qemu = "6"
```

## conf/machine/vexpress.conf
```bitbake
#@TYPE: Machine
#@NAME: vexpress

#@DESCRIPTION: Machine configuration for vexpress systems


MACHINE_EXTRA_RRECOMMENDS = " kernel-modules kernel-devicetree"

EXTRA_IMAGEDEPENDS += "u-boot"

require conf/machine/include/qemu.inc
#include conf/machine/include/tune-cortexa9.inc
include conf/machine/include/arm/arch-armv5-dsp.inc

IMAGE_FSTYPES += "tar.bz2 jffs2"
EXTRA_IMAGECMD_jffs2 = "-lnp "

SERIAL_CONSOLE = "115200 ttyO0"

PREFERRED_PROVIDER_virtual/kernel ?= "linux-yocto"


KERNEL_IMAGETYPE = "zImage"
#KERNEL_DEVICETREE = "am335x-bone.dtb am335x-boneblack.dtb"
KERNEL_DEVICETREE = "vexpress-v2p-ca9.dtb"
KERNEL_EXTRA_ARGS += "LOADADDR=${UBOOT_ENTRYPOINT}"

#SPL_BINARY = "MLO"
#UBOOT_SUFFIX = "img"
UBOOT_SUFFIX = "bin"
UBOOT_MACHINE = "vexpress_ca9x4_config"
UBOOT_ENTRYPOINT = "0x60800000"
UBOOT_LOADADDRESS = "0x60800000"

UBOOT_ELF ?= "u-boot"

# Needed to skip a particular QA check that doesn't apply to U-boot's binary.
INSANE_SKIP_u-boot += "ldflags"

#MACHINE_FEATURES = "usbgadget usbhost vfat alsa"

#IMAGE_BOOT_FILES ?= "u-boot.${UBOOT_SUFFIX} MLO"
IMAGE_BOOT_FILES ?= "u-boot.${UBOOT_SUFFIX}"
```
